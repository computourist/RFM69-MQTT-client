// RFM69 RFID node sketch
//
// This node talks to the MQTT-Gateway and will:
// - send sensor data periodically 
// - detect and read RFID cards and send the UID to the MQTT broker; 
//
//
// Hardware used is a 3.3 Volt 8MHz arduino Pro; this is easier to interface to RFM69 and RFID-RC522.
// Power requirements dictate that a reparate 3.3 Volts regulator is used to power both RFM69 and RFID reader 
// A RED led (D7) is used to indicate an RFID card has been detected and read. It will stay on during HOLDOFF msec.
//
// Current defined devices are:
//
//	0	uptime:			read uptime node in minutes
//	1	node:			read/set transmission interval in seconds, 0 means no periodic transmission
//	2	RSSI:			read radio signal strength
//	3	Version:		read version node software
//	4	voltage:		read battery level
//	5	ACK:			read/set acknowledge message after a 'set' request
//	7	timer:			read/set timer for LED activation, 0 means no timer
//	
//	72	UID:			send UID of detected RFID token
//	90	error:			tx only: error message if no wireless connection (generated by gateway)
//	92	error:			tx only: device not supported
//	99	wakeup:			tx only: first message sent on node startup
//
//
// Pin layout used:
// ------------------------------------------------
//             MFRC522      RFM69       Arduino  
//             Reader/PCD   	           Uno      
// Signal      Pin          Pin           Pin       
// ------------------------------------------------
// INT0		-		DIO0		D2
// REDLED	-		-		D7
// SPI SS RFM	-		NSS		D4
// RST/Reset	RST		-		D9
// SPI SS RFID	SDA(SS)		-		D10
// SPI MOSI	MOSI		MOSI		D11
// SPI MISO	MISO		MISO		D12
// SPI SCK	SCK		SCK		D13
//
//
//
//	A debug mode is included which outputs messages on the serial output
//
//	MFRC522 library at: https://github.com/miguelbalboa/rfid
//	Make sure to change the library file: MFRC522.cpp:
//	- add "cli();" to every occurrence of "digitalWrite(_chipSelectPin,LOW)"
//	- add "sei();" to every occurrence of "digitalWrite(_chipSelectPin,HIGH)"
//
//
//	RFM69 Library by Felix Rusu - felix@lowpowerlab.com
//	Get the RFM69 library at: https://github.com/LowPowerLab/
//
//	version 1.0 by Computourist@gmail.com March 2015
//
#include <MFRC522.h>
#include <RFM69.h>
#include <SPI.h>


//
// CONFIGURATION PARAMETERS
//
#define NODEID 5 					// unique node ID within the closed network
#define GATEWAYID 1					// node ID of the Gateway is always 1
#define NETWORKID 100					// network ID of the network
#define ENCRYPTKEY "xxxxxxxxxxxxxxxx" 			// 16-char encryption key; same as on Gateway!
#define DEBUG						// uncomment for debugging
#define VERSION "RFID V1.0"				// this value can be queried as device 3

// Wireless settings	Match frequency to the hardware version of the radio

//#define FREQUENCY RF69_433MHZ
#define FREQUENCY RF69_868MHZ
//#define FREQUENCY RF69_915MHZ

#define IS_RFM69HW 					// uncomment only for RFM69HW! 
#define ACK_TIME 50 					// max # of ms to wait for an ack

// pin setting
#define RFID_RST	9				// reset pin RC522
#define RFID_SS		10				// Slave Select pin RC522
#define RFM_SS		4				// Slave Select pin RFM69
#define REDLED		7				// Red LED pin
#define SERIAL_BAUD 115200
#define HOLDOFF 2000					// blocking period between RFID detection

//
//	STARTUP DEFAULTS
//
long 	TXinterval = 20;				// periodic transmission interval in seconds


//
//	VARIABLES
//
long	lastPeriod = -1;				// timestamp last transmission
long 	lastOn = -1;					// timestamp last buttonpress
long	lastMinute = -1;				// timestamp last minute
long	upTime = 0;					// uptime in minutes

int	signalStrength;					// radio signal strength
bool	setAck = false;					// send ACK message on 'SET' request
bool	send0, send1, send2, send3, send4;
bool	send5, send7;
bool	send92;						// message triggers
bool	promiscuousMode = false; 			// only listen to nodes within the closed network
bool 	wakeUp = true;					// wakeup flag
long	lastCardDetect=-1;				// timestamp of last card detection
bool	cardDetect = false;				// flag to indicate an RFID card has been detected
bool	block=false;					// block RFID reader during holdoff
bool	redLedState=false;				// state of red LED
unsigned char	UID[5] ;				// holds RFID code in numbers
String RFID_Code;					// holds RFID code in ASCII



typedef struct {					// Radio packet format
int	nodeID;						// node identifier
int	devID;						// device identifier 
int	cmd;						// read or write
long	intVal;						// integer payload
float	fltVal;						// floating payload
char	payLoad[32];					// string payload
} Message;

Message mes;



MFRC522 mfrc522(RFID_SS, RFID_RST);			// Create MFRC522 instance

RFM69 radio;						// Create RFM69 instance

//
//=====================		SETUP	========================================
//
void setup() {
#ifdef DEBUG
	Serial.begin(SERIAL_BAUD);
#endif
pinMode(REDLED, OUTPUT);				// set LED output
digitalWrite(REDLED, LOW);
radio.setCS(RFM_SS);					// set SS pin
radio.initialize(FREQUENCY,NODEID,NETWORKID);		// initialise radio 
#ifdef IS_RFM69HW
radio.setHighPower(); 					// only for RFM69HW!
#endif
radio.encrypt(ENCRYPTKEY);				// set radio encryption	
radio.promiscuous(promiscuousMode);			// only listen to closed network
wakeUp = true;						// send wakeup message
SPI.begin();
mfrc522.PCD_Init();	

#ifdef DEBUG
	Serial.print("Node Software Version ");
	Serial.println(VERSION);
	Serial.print("\nTransmitting at ");
	Serial.print(FREQUENCY==RF69_433MHZ ? 433 : FREQUENCY==RF69_868MHZ ? 868 : 915);
	Serial.println(" Mhz...");
#endif
}	// end setup

//
//
//====================		MAIN	========================================
//
void loop() {
	block = (millis()-lastCardDetect) < HOLDOFF;

if (!block) {
	if (redLedState) {					// turn off red LED
			redLedState = false;
			digitalWrite(REDLED,LOW);
		}
	if ( mfrc522.PICC_IsNewCardPresent()) {			// Look for new cards
			lastCardDetect = millis();
			redLedState = true;
			digitalWrite(REDLED,HIGH);  
		}

	if ( mfrc522.PICC_ReadCardSerial()) { 			// Select one of the cards
			cardDetect = true;
			Serial.println("Scanned PICC's UID:");
			for (int i = 0; i < 4; i++) { //
				UID[i] = mfrc522.uid.uidByte[i];
				Serial.print(UID[i], HEX);
				Serial.print(" ");
			}

	Serial.println("");
	mfrc522.PICC_HaltA(); 					// Stop reading
		}

	}	

// RECEIVE radio input
//
if (receiveData()) parseCmd();				// receive and parse any radio input


// UPTIME 
//

if (lastMinute != (millis()/60000)) {			// another minute passed ?
	lastMinute = millis()/60000;
	upTime++;
	}

// PERIODIC TRANSMISSION
//

if (TXinterval > 0)
{
int currPeriod = millis()/(TXinterval*1000);
if (currPeriod != lastPeriod) {				// interval elapsed ?
	lastPeriod = currPeriod;
	
// list of sensordata to be sent periodically..
// remove comment to include parameter in transmission
//	send1 = true;					// send transmission interval
	send2 = true; 					// signal strength
//	send4 = true;					// voltage level
//	send16 = true;					// actuator state

	}
}

// SEND RADIO PACKETS
//

sendMsg();						// send any radio messages 

}		// end loop

//
//
//=====================		FUNCTIONS	==========================================

//
//========		RECEIVEDATA : receive data from gateway over radio
//

bool receiveData() {
bool validPacket = false;
if (radio.receiveDone())				// check for received packets
{
if (radio.DATALEN != sizeof(mes))			// wrong message size means trouble
#ifdef DEBUG
	Serial.println("invalid message structure..")
#endif
;
else
{
	mes = *(Message*)radio.DATA;
	validPacket = true;				// YES, we have a packet !
	signalStrength = radio.RSSI;
#ifdef DEBUG
	Serial.print(mes.devID);
	Serial.print(", ");
	Serial.print(mes.cmd);
	Serial.print(", ");
	Serial.print(mes.intVal);
	Serial.print(", ");
	Serial.print(mes.fltVal);
	Serial.print(", RSSI= ");
	Serial.println(radio.RSSI);
	Serial.print("Node: ");
	Serial.println(mes.nodeID);
#endif	
}
}
if (radio.ACKRequested()) radio.sendACK();		// respond to any ACK request
return validPacket;					// return code indicates packet received
}		// end recieveData

//
//
//==============		PARSECMD: analyse messages and execute commands received from gateway
//

void parseCmd() {					// parse messages received from the gateway

send0 = false;						// initialise all send triggers
send1 = false;
send2 = false;
send3 = false; 
send4 = false;
send5 = false;
send7 = false;
send92 = false;

switch (mes.devID)					// devID indicates device (sensor) type
{
case (0):						// uptime
if (mes.cmd == 1) send0 = true;
break;
case (1):						// polling interval in seconds
if (mes.cmd == 0) {					// cmd == 0 means write a value
	TXinterval = mes.intVal;			// change interval to radio packet value
	if (TXinterval <10 && TXinterval !=0) TXinterval = 10;	// minimum interval is 10 seconds
	if (setAck) send1 = true;			// send message if required
#ifdef DEBUG
	Serial.print("Setting interval to ");
	Serial.print(TXinterval);
	Serial.println(" seconds");
#endif
}
else send1 = true;					// cmd == 1 is a read request, so send polling interval 
break;
case (2): 						// signal strength
if (mes.cmd == 1) send2 = true;
break;
case (3): 						// software version
if (mes.cmd == 1) send3 = true;
break;
case (4): 						// battery level
if (mes.cmd == 1) send4 = true;
break;
case (5): 						// set ack status
if (mes.cmd == 0) {
	if (mes.intVal == 0) setAck = false;
	if (mes.intVal == 1) setAck = true;
	if (setAck) send5 = true;			// acknowledge message ?
}
else send5 = true;					// read request means schedule a message
break;

default: send92 = true;					// no valid device parsed
}
}	// end parseCmd

//
//
//======================		SENDMSG: sends messages that are flagged for transmission
//

void sendMsg() {					// prepares values to be transmitted
bool tx = false; 					// transmission flag
mes.nodeID=NODEID;
mes.intVal = 0;
mes.fltVal = 0;
mes.cmd = 0;						// '0' means no action needed in gateway
int i;
for ( i = 0; i < sizeof(VERSION); i++){
mes.payLoad[i] = VERSION[i];	}
mes.payLoad[i] = '\0';					// software version in payload string

if (wakeUp) {						// send wakeUp call 
	mes.devID = 99;	
	wakeUp = false;					// reset transmission flag for this message
	txRadio();					// transmit
}
if (send0) {
	mes.devID = 0;
	mes.intVal = upTime;				// minutes uptime
	send0 = false;
	txRadio();
}
if (send1) {						// transmission interval
	mes.devID = 1;
	mes.intVal = TXinterval;			// seconds (integer)
	send1 = false;
	txRadio();
}
if (send2) {
	mes.devID = 2;
	mes.intVal = signalStrength;			// signal strength (integer)
	send2 = false;
	txRadio();
}
if (send3) {						// node software version (string)
	mes.devID = 3;					// already stored in payload string
	send3 = false;
	txRadio();
}
if (send4) {						// measure voltage..
	mes.devID = 4;	
	long result;					// Read 1.1V reference against AVcc
	ADMUX = _BV(REFS0) | _BV(MUX3) | _BV(MUX2) | _BV(MUX1);
	delay(2);					// Wait for Vref to settle
	ADCSRA |= _BV(ADSC);				// Convert
	while (bit_is_set(ADCSRA,ADSC));
	result = ADCL;
	result |= ADCH<<8;
	result = 1126400L / result; 			// Back-calculate in mV
	mes.fltVal = float(result/1000.0);		// Voltage in Volt (float)
	txRadio();
	send4 = false;
}
if (send5) {						// Acknowledge on 'SET'
	mes.devID = 5;
	if (setAck) mes.intVal = 1; else mes.intVal = 0;// state (integer)
	send5 = false;
	txRadio();
}


if (cardDetect) {						// RFID card detected
	mes.devID = 72;
	RFID_Code="";
	for ( i = 0; i < 4; i++){			// fill string with 4 Hex numbers
	RFID_Code += String(UID[i],HEX);
	}
	RFID_Code.toUpperCase();
	for (i= 0; i<9 ; i++){				// copy string (6 characters) to payload
		mes.payLoad[i] = RFID_Code[i];	
	}
	cardDetect = false;
	txRadio();
}
if (send92) {						// error message invalid device
	mes.intVal = mes.devID;
	mes.devID = 92;
	send92 = false;
	txRadio();
}

}
//
//
//=======================		TXRADIO
//

void txRadio()						// Transmits the 'mes'-struct to the gateway
{
if (radio.sendWithRetry(GATEWAYID, (const void*)(&mes), sizeof(mes)))
#ifdef DEBUG
	{Serial.print(" message ");
	Serial.print(mes.devID);
	Serial.println(" sent...");}
	else Serial.println("No connection...")
#endif
;}	// end txRadio






