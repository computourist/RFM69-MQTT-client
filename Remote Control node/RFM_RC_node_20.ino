// RFM69 RC node sketch
//
// This node talks to the MQTT-Gateway and will send out commands to RC-controlled mains switches.
// I use devices of brand KlikAanKlikUit. The library used supports other European brands.
//
//
// Hardware used is a 3.3 Volt 8MHz arduino Pro; this is easier to interface to RFM69 
//
// A 433 MHZ transmitter is used to send out commands in the appropriate format.
// The RemoteSwitch library by Randy Simons is used 
// Get this library at : https://bitbucket.org/fuzzillogic
// Commands are sent as a string and have the following format:
//	KuKa XY ON of KuKa XY OFF where XY is the device address of the switch.
//
// Defined devices for this node are:
//
//	0	uptime:			read uptime node in minutes
//	1	node:			read/set transmission interval in seconds, 0 means no periodic transmission
//	2	RSSI:			read radio signal strength
//	3	Version:		read version node software
//	4	voltage:		read battery level
//	5	ACK:			read/set acknowledge message after a 'set' request
//	9	retry:			read number of retransmissions needed in radiolink
//	72	command:		the command is sent as a string
//	90	error:			tx only: error message if no wireless connection (generated by gateway)
//	92	error:			tx only: device not supported
//	99	wakeup:			tx only: first message sent on node startup
//
// The RFM69 is connected to the following pins:
// - D13	SCK
// - D12	MISO
// - D11	MOSI
// - D10	SS
// - D2		DIO0
//
// The 433 Mhz transmitter is connected to pin D3, GND and +5 Volt.
//
//	RFM69 Library by Felix Rusu - felix@lowpowerlab.com
//	Get the RFM69 library at: https://github.com/LowPowerLab/
//
//	version 1.0 by Computourist@gmail.com Feb 2015
//	version 2.0 fixed bug in function TXradio that prevented retransmission of radio packets ; oct 2015
//	

#include <RFM69.h>
#include <SPI.h>
#include <RemoteTransmitter.h>

//
// CONFIGURATION PARAMETERS
//
#define NODEID 4 					// unique node ID within the closed network
#define GATEWAYID 1					// node ID of the Gateway is always 1
#define NETWORKID 100					// network ID of the network
#define ENCRYPTKEY "xxxxxxxxxxxxxxxx" 			// 16-char encryption key; same as on Gateway!
#define DEBUG						// uncomment for debugging
#define VERSION "RC V1.0"				// this value can be queried as device 3

// Wireless settings	Match frequency to the hardware version of the radio

//#define FREQUENCY RF69_433MHZ
#define FREQUENCY RF69_868MHZ
//#define FREQUENCY RF69_915MHZ

#define IS_RFM69HW 					// uncomment only for RFM69HW! 
#define ACK_TIME 50 					// max # of ms to wait for an ack

#define TXDATA 9						// Transmitter pin
#define SERIAL_BAUD 115200
#define HOLDOFF 10000					// blocking period between button messages

//
//	STARTUP DEFAULTS
//
long 	TXinterval = 120;				// periodic transmission interval in seconds
long	TIMinterval = 20;				// timer interval in seconds
bool	ackButton = false;				// flag for message on button press
bool	toggleOnButton = true;				// toggle output on button press

//
//	VARIABLES
//
long	lastPeriod = -1;				// timestamp last transmission
long 	lastBtnPress = -1;				// timestamp last buttonpress
long	lastMinute = -1;				// timestamp last minute
long	upTime = 0;						// uptime in minutes
int		signalStrength;					// radio signal strength
bool	setAck = true;					// send ACK message on 'SET' request
bool	send0, send1, send2, send3, send4;
bool	send5, send9, send72, send92;			// message triggers
bool	promiscuousMode = false; 			// only listen to nodes within the closed network
bool	curState = true;				// current button state
bool	lastState = true;				// last button state
bool 	wakeUp = true;					// wakeup flag
bool	msgBlock = false;				// flag to hold button messages to prevent overload
char	KKgroup;						// Group of the targeted KAKU device
int		KKnum;							// Code of the targeted KAKU device
bool	error;							// error flag
bool	retx = true; 					// flag to signal retransmission
int	numtx;							// number of retransmissions

typedef struct {					// Radio packet format
int	nodeID;						// node identifier
int	devID;						// device identifier 
int	cmd;						// read or write
long	intVal;						// integer payload
float	fltVal;						// floating payload
char	payLoad[32];					// string payload
} Message;

Message mes;

KaKuTransmitter kakuTx(TXDATA); 	// KaKu transmitter on pin TXDATA
RFM69 radio;

//
//=====================		SETUP	========================================
//
void setup() {
#ifdef DEBUG
	Serial.begin(SERIAL_BAUD);
#endif

radio.initialize(FREQUENCY,NODEID,NETWORKID);		// initialise radio 
#ifdef IS_RFM69HW
radio.setHighPower(); 					// only for RFM69HW!
#endif
radio.encrypt(ENCRYPTKEY);				// set radio encryption	
radio.promiscuous(promiscuousMode);			// only listen to closed network
wakeUp = true;						// send wakeup message

#ifdef DEBUG
	Serial.print("Node Software Version ");
	Serial.println(VERSION);
	Serial.print("\nTransmitting at ");
	Serial.print(FREQUENCY==RF69_433MHZ ? 433 : FREQUENCY==RF69_868MHZ ? 868 : 915);
	Serial.println(" Mhz...");
#endif
}	// end setup

//
//
//====================		MAIN	========================================
//
void loop() {
// RECEIVE radio input
//
if (receiveData()) parseCmd();				// receive and parse any radio input


// UPTIME 
//

if (lastMinute != (millis()/60000)) {		// another minute passed ?
	lastMinute = millis()/60000;
	upTime++;
	}

// PERIODIC TRANSMISSION
//

if (TXinterval > 0)
{
int currPeriod = millis()/(TXinterval*1000);
if (currPeriod != lastPeriod) {				// interval elapsed ?
	lastPeriod = currPeriod;
	
// list of sensordata to be sent periodically..
// remove comment to include parameter in transmission
 
//	send1 = true;					// send transmission interval
	send2 = true; 					// signal strength
//	send4 = true;					// voltage level
//	send9 = true;					// number of retransmissions

	}
}

// SEND RADIO PACKETS
//

sendMsg();						// send any radio messages 

}		// end loop

//
//
//=====================		FUNCTIONS	==========================================

//
//========		RECEIVEDATA : receive data from gateway over radio
//

bool receiveData() {
bool validPacket = false;
if (radio.receiveDone())				// check for received packets
{
if (radio.DATALEN != sizeof(mes))			// wrong message size means trouble
#ifdef DEBUG
	Serial.println("invalid message structure..")
#endif
;
else
{
	mes = *(Message*)radio.DATA;
	validPacket = true;				// YES, we have a packet !
	signalStrength = radio.RSSI;
#ifdef DEBUG
	Serial.print(mes.devID);
	Serial.print(", ");
	Serial.print(mes.cmd);
	Serial.print(", ");
	Serial.print(mes.intVal);
	Serial.print(", ");
	Serial.print(mes.fltVal);
	Serial.print(", RSSI= ");
	Serial.println(radio.RSSI);
	Serial.print("Node: ");
	Serial.println(mes.nodeID);
        for (int i=0; i<sizeof(mes.payLoad);i++) Serial.print(mes.payLoad[i]);
        Serial.println();
#endif	
}
}
if (radio.ACKRequested()) radio.sendACK();		// respond to any ACK request
return validPacket;					// return code indicates packet received
}		// end recieveData

//
//
//==============		PARSECMD: analyse messages and execute commands received from gateway
//

void parseCmd() {					// parse messages received from the gateway
send0 = false;						// initialise all send triggers
send1 = false;
send2 = false;
send3 = false; 
send4 = false;
send5 = false;
send9 = false;
send72 = false;
send92 = false;

switch (mes.devID)					// devID indicates device (sensor) type
{
case (0):							// uptime
if (mes.cmd == 1) send0 = true;
break;
case (1):						// polling interval in seconds
if (mes.cmd == 0) {					// cmd == 0 means write a value
	TXinterval = mes.intVal;			// change interval to radio packet value
	if (TXinterval <10 && TXinterval !=0) TXinterval = 10;	// minimum interval is 10 seconds
	if (setAck) send1 = true;			// send message if required
#ifdef DEBUG
	Serial.print("Setting interval to ");
	Serial.print(TXinterval);
	Serial.println(" seconds");
#endif
}
else send1 = true;					// cmd == 1 is a read request, so send polling interval 
break;
case (2): 						// signal strength
if (mes.cmd == 1) send2 = true;
break;
case (3): 						// software version
if (mes.cmd == 1) send3 = true;
break;
case (4): 						// battery level
if (mes.cmd == 1) send4 = true;
break;
case (5): 						// set ack status
if (mes.cmd == 0) {
	if (mes.intVal == 0) setAck = false;
	if (mes.intVal == 1) setAck = true;
	if (setAck) send5 = true;			// acknowledge message ?
}
else send5 = true;					// read request means schedule a message
break;
case (9):						// retransmissions
if (mes.cmd == 1) send9 = true;
break;
case (72):						// string
if (mes.cmd == 0) {
		String txtLine = String ((char*)mes.payLoad);
		error = false;
#ifdef DEBUG
		Serial.print("Received string: ");
		Serial.println(txtLine);
		Serial.print("Length: ");
		Serial.println(txtLine.length());
#endif
	if (txtLine.substring(0,4) == "KAKU") {
	KKgroup = txtLine.charAt(5);
	KKnum = txtLine.charAt(6) - '0';
#ifdef DEBUG
		Serial.print("KAKU OK:   ");
		Serial.print("group and code:  ");
		Serial.print(KKgroup);
		Serial.print(" :: ");
		Serial.println(KKnum);
#endif
	if ((KKgroup - 'A' >=0 && KKgroup - 'A' < 16) &&
		(KKnum >=0 && KKnum <=9)) {
		if (txtLine.substring(8) == "ON") kakuTx.sendSignal(KKgroup, KKnum, true);
		if (txtLine.substring(8) == "OFF") kakuTx.sendSignal(KKgroup, KKnum, false);
		if (!(txtLine.substring(8) == "ON" || txtLine.substring(8) == "OFF")) error = true;
	} else error = true;
} else error = true;


		if (error || setAck) send72 = true;			// acknowledge message ?
}
break;
default: send92 = true;				// no valid device parsed
}
}	// end parseCmd

//
//
//======================		SENDMSG: sends messages that are flagged for transmission
//

void sendMsg() {					// prepares values to be transmitted
bool tx = false; 					// transmission flag
mes.nodeID=NODEID;
mes.intVal = 0;
mes.fltVal = 0;
mes.cmd = 0;						// '0' means no action needed in gateway
int i;
for ( i = 0; i < sizeof(VERSION); i++){
mes.payLoad[i] = VERSION[i];	}
mes.payLoad[i] = '\0';					// software version in payload string

if (wakeUp) {						// send wakeUp call 
	mes.devID = 99;	
	wakeUp = false;					// reset transmission flag for this message
	txRadio();					// transmit
}
if (send0) {
	mes.devID = 0;
	mes.intVal = upTime;			// minutes uptime
	send0 = false;
	txRadio();
}
if (send1) {						// transmission interval
	mes.devID = 1;
	mes.intVal = TXinterval;			// seconds (integer)
	send1 = false;
	txRadio();
}
if (send2) {
	mes.devID = 2;
	mes.intVal = signalStrength;			// signal strength (integer)
	send2 = false;
	txRadio();
}
if (send3) {						// node software version (string)
	mes.devID = 3;					// already stored in payload string
	send3 = false;
	txRadio();
}
if (send4) {							// measure voltage..
	mes.devID = 4;	
	long result;						// Read 1.1V reference against AVcc
	ADMUX = _BV(REFS0) | _BV(MUX3) | _BV(MUX2) | _BV(MUX1);
	delay(2);						// Wait for Vref to settle
	ADCSRA |= _BV(ADSC);					// Convert
	while (bit_is_set(ADCSRA,ADSC));
	result = ADCL;
	result |= ADCH<<8;
	result = 1126400L / result; 				// Back-calculate in mV
	mes.fltVal = float(result/1000.0);			// Voltage in Volt (float)
	txRadio();
	send4 = false;
}
if (send5) {							// Acknowledge on 'SET'
	mes.devID = 5;
	if (setAck) mes.intVal = 1; else mes.intVal = 0;	// state (integer)
	send5 = false;
	txRadio();
}
if (send9) {						// number of retransmissions
	mes.devID = 9;
	mes.intVal = numtx;			// number (integer)
	send9 = false;
	txRadio();
}
if (send72) {
    mes.devID = 72;
	mes.intVal = 1;
	if (error) sprintf(mes.payLoad, "KAKU syntax error");
	else sprintf(mes.payLoad, "command received");
	send72 = false;
    txRadio();
}
if (send92) {							// error message invalid device
	mes.intVal = mes.devID;
	mes.devID = 92;
        send92 = false;
	txRadio();
}

}
//
//
//=======================		TXRADIO
//

void txRadio()							// Transmits the 'mes'-struct to the gateway
{
retx = true;
int i = 0;

while (retx && i<6) {
if (radio.sendWithRetry(GATEWAYID, (const void*)(&mes), sizeof(mes),5)) {
	retx = false;
#ifdef DEBUG
	Serial.print(" message ");
	Serial.print(mes.devID);
	Serial.println(" sent...");
#endif
} else delay(500);
i++;
}
numtx = i;							// store number of retransmissions needed
#ifdef DEBUG
	if (retx) Serial.println("No connection...")
#endif
;}	// end txRadio






