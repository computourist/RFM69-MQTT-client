// RFM69 LCD node sketch
//
// This node talks to the MQTT-Gateway and will:
// - send sensor data periodically and on-demand
// - receive commands from the gateway to show on an LCD display
// - receive commands from the gateway to change settings
//
// This node will work with gateway software from release 2.1
//
// Text messages should be targetted to device 72 and have the follwing format:
// x:yyyyyyyyyyy
// where x is the line number (0-1 or 0-3 depending on LCD device) and yyyy is the text to be displayed.
//
// There are two buttons that generate button pressed codes (dev 40 & 41); 
// Once pressed a button is locked for "HOLDOFF" seconds to prevent flooding the network.
//
// Hardware used is a 3.3 Volt 8MHz arduino Pro; this is easier to interface to RFM69 
// The display is used at +5 Volts, no special interfacing needed.
//
// The RFM69 module is connected according to the diagram of the DTH-node.
// Buttons are connected to D0 and D1 with pullups resistors (10k) to 3.3 Volts.
// Note that debug over serial port cannot be used simultaneously. (D0 and D1 are Tx and Rx)
// A 44780 type display is used, with the library as described in http://arduino.cc/en/Tutorial/LiquidCrystal
// The LCD display is connected as follows:
// - LCD RS pin to digital pin 3
// - LCD Enable pin to digital pin 4
// - LCD D4 pin to digital pin 5
// - LCD D5 pin to digital pin 6
// - LCD D6 pin to digital pin 7
// - LCD D7 pin to digital pin 8
// - LCD R/W pin to ground
// - a potmeter (10K) between GND and +5 Volt for contrast adjustment, tap to pin 3 of the display.
//
// Defined node devices in this sketch are:
//
//	0	uptime:			read uptime node in minutes
//	1	node:			read/set transmission interval in seconds, 0 means no periodic transmission
//	2	RSSI:			read radio signal strength
//	3	Version:		read version node software
//	4	voltage:		read battery level
//	5	acknowledge:	read/set acknowledge flag for text messages and SET actions
//	40	BTN1:			sends a message when state changes
//	41	BTN2:			sends a message when state changes
//	72	display:		display the text sent in the message payload
//	90	error:			tx only: error message if no wireless connection (generated by gateway)
//	92	error:			tx only: device not supported
//	99	wakeup:			tx only: first message sent on node startup
//
//
//	RFM69 Library by Felix Rusu - felix@lowpowerlab.com
//	Get the RFM69 library at: https://github.com/LowPowerLab/
//
//	version 1.0 by Computourist@gmail.com Feb 2015
//	version 2.0 changed binary input handling according to Gateway V2.2	to facilitate handling in Openhab; March 2015
//	

#include <RFM69.h>
#include <SPI.h>
#include <LiquidCrystal.h>

//
// CONFIGURATION PARAMETERS
//
#define NODEID 3 					// unique node ID within the closed network
#define GATEWAYID 1					// node ID of the Gateway is always 1
#define NETWORKID 100					// network ID of the network
#define ENCRYPTKEY "xxxxxxxxxxxxxxxx" 			// 16-char encryption key; same as on Gateway!
//#define DEBUG						// uncomment for debugging
#define VERSION "LCD V2.0"				// this value can be queried as device 3

// Wireless settings	Match frequency to the hardware version of the radio

//#define FREQUENCY RF69_433MHZ
#define FREQUENCY RF69_868MHZ
//#define FREQUENCY RF69_915MHZ

#define SERIAL_BAUD 115200
#define IS_RFM69HW 					// uncomment only for RFM69HW! 
#define ACK_TIME 50 					// max # of ms to wait for an ack

#define BTN1	0					// buttons
#define BTN2	1
#define	ROWS	4					// # of rows on the LCD
#define COLS	20					// # of columns
#define HOLDOFF 2000				// blocking period between button messages

//
//	STARTUP DEFAULTS
//
long 	TXinterval = 20;				// periodic transmission interval in seconds
bool	setAck = true;				// flag for message on text message


//
//	VARIABLES
//
long	lastPeriod = -1;				// timestamp last transmission
long 	lastBtnPress = -1;				// timestamp last buttonpress
long	lastMinute = -1;				// timestamp last minute
long	upTime = 0;						// uptime in minutes
int		signalStrength;					// radio signal strength
int		line;							// Display line
int		i,length;
bool	send0, send1, send2, send3, send4;
bool	send5, send40, send41;
bool	send72, send92;		                        // message triggers
bool	promiscuousMode = false; 			// only listen to nodes within the closed network
bool	curStateBtn1 = true;				// current button state
bool	curStateBtn2 = true;				// current button state
bool	btn1Last, btn2Last;			// button state flags
bool 	wakeUp = true;					// wakeup flag
bool	msgBlock = false;				// flag to hold button messages to prevent overload
char    buff_mess[32];


typedef struct {					// Radio packet format
int	nodeID;						// node identifier
int	devID;						// device identifier 
int	cmd;						// read or write
long	intVal;						// integer payload
float	fltVal;						// floating payload
char	payLoad[32];					// string payload
} Message;

Message mes;

RFM69 radio;

LiquidCrystal lcd(3, 4, 5, 6, 7, 8);		// initialize LCD with the correct interface pins

//
//=====================		SETUP	========================================
//
void setup() {
#ifdef DEBUG
	Serial.begin(SERIAL_BAUD);
#endif

radio.initialize(FREQUENCY,NODEID,NETWORKID);		// initialise radio 
#ifdef IS_RFM69HW
radio.setHighPower(); 					// only for RFM69HW!
#endif
radio.encrypt(ENCRYPTKEY);				// set radio encryption	
radio.promiscuous(promiscuousMode);			// only listen to closed network
wakeUp = true;						// send wakeup message

lcd.begin(COLS, ROWS);						// set up the LCD's number of columns and rows: 
lcd.print("Startup ");				// Print boot message to the LCD.
lcd.print (VERSION);
#ifdef DEBUG
	lcd.setCursor(0,2);
        lcd.print("DEBUG mode !!!");	
        Serial.print("Node Software Version ");
	Serial.println(VERSION);
	Serial.print("\nTransmitting at ");
	Serial.print(FREQUENCY==RF69_433MHZ ? 433 : FREQUENCY==RF69_868MHZ ? 868 : 915);
	Serial.println(" Mhz...");
#endif
}	// end setup

//
//
//====================		MAIN	========================================
//
void loop() {
// RECEIVE radio input
//
if (receiveData()) parseCmd();				// receive and parse any radio input

// DETECT BUTTON PRESS
//
// This works NOT in debug mode; Tx and RX pins are being used !!!!!
//
#ifndef DEBUG
msgBlock = (millis() - lastBtnPress < HOLDOFF);		// hold-off time for additional button messages
if (!msgBlock) {
  curStateBtn1 = digitalRead(BTN1);
if (curStateBtn1 != btn1Last) {							// button pressed ?
	delay(5);
	lastBtnPress = millis();			// take timestamp 
	send40 = true;						// set button message flag
	} 
btn1Last = curStateBtn1;

curStateBtn2 = digitalRead(BTN2);
if  (curStateBtn2 != btn2Last) {							// button pressed ?
	delay(5);
	lastBtnPress = millis();			// take timestamp 
	send41 = true;						// set button message flag
	} 
btn2Last = curStateBtn2;
}
#endif

// UPTIME 
//

if (lastMinute != (millis()/60000)) {		// another minute passed ?
	lastMinute = millis()/60000;
	upTime++;
	}

// PERIODIC TRANSMISSION
//

if (TXinterval > 0)
{
int currPeriod = millis()/(TXinterval*1000);
if (currPeriod != lastPeriod) {				// interval elapsed ?
	lastPeriod = currPeriod;
	
// list of sensordata to be sent periodically..
// remove comment to include parameter in transmission
 
//	send0 = true;					// send uptime
	send2 = true; 					// signal strength
//	send4 = true;					// voltage level
	}
}

// SEND RADIO PACKETS
//

sendMsg();						// send any radio messages 

}		// end loop

//
//
//=====================		FUNCTIONS	==========================================

//
//========		RECEIVEDATA : receive data from gateway over radio
//

bool receiveData() {
bool validPacket = false;
if (radio.receiveDone())				// check for received packets
{
if (radio.DATALEN != sizeof(mes))			// wrong message size means trouble
#ifdef DEBUG
	Serial.println("invalid message structure..")
#endif
;
else
{
	mes = *(Message*)radio.DATA;
	validPacket = true;				// YES, we have a packet !
	signalStrength = radio.RSSI;
#ifdef DEBUG
	Serial.print(mes.devID);
	Serial.print(", ");
	Serial.print(mes.cmd);
	Serial.print(", ");
	Serial.print(mes.intVal);
	Serial.print(", ");
	Serial.print(mes.fltVal);
	Serial.print(", RSSI= ");
	Serial.println(radio.RSSI);
	Serial.print("Node: ");
	Serial.println(mes.nodeID);
//	for (int i=0; i<32;i++) Serial.print(mes.payLoad[i]);
        Serial.println();
#endif	
}
}
if (radio.ACKRequested()) radio.sendACK();		// respond to any ACK request
return validPacket;					// return code indicates packet received
}		// end recieveData

//
//
//==============		PARSECMD: analyse messages and execute commands received from gateway
//

void parseCmd() {					// parse messages received from the gateway
send0 = false;						// initialise all send triggers
send1 = false;
send2 = false;
send3 = false; 
send4 = false;
send5 = false;
send40 = false;
send41 = false;
send92 = false;

switch (mes.devID)					// devID indicates device (sensor) type
{
case (0):							// uptime
if (mes.cmd == 1) send0 = true;
break;
case (1):						// polling interval in seconds
if (mes.cmd == 0) {					// cmd == 0 means write a value
	TXinterval = mes.intVal;			// change interval to radio packet value
	if (TXinterval <10 && TXinterval !=0) TXinterval = 10;	// minimum interval is 10 seconds
	if (setAck) send1 = true;			// send message if required
#ifdef DEBUG
	Serial.print("Setting interval to ");
	Serial.print(TXinterval);
	Serial.println(" seconds");
#endif
}
else send1 = true;					// cmd == 1 is a read request, so send polling interval 
break;
case (2): 						// signal strength
if (mes.cmd == 1) send2 = true;
break;
case (3): 						// software version
if (mes.cmd == 1) send3 = true;
break;
case (4): 						// battery level
if (mes.cmd == 1) send4 = true;
break;
case (5): 						// set ack status
if (mes.cmd == 0) {
	if (mes.intVal == 0) setAck = false;
	if (mes.intVal == 1) setAck = true;
	if (setAck) send5 = true;			// acknowledge message ?
}
else send5 = true;					// read request means schedule a message
break;
case (40): 						// Button 1
if (mes.cmd == 1) send40 = true;
break;
case (41): 						// Button 2
if (mes.cmd == 1) send41 = true;
break;
case (72):						// string
if (mes.cmd == 0) {					// cmd == 0 means write a value
	
        String txtLine = String ((char*)mes.payLoad);
#ifdef DEBUG
        Serial.print("Received string: ");
	Serial.println(txtLine);
        Serial.print("Length: ");
	Serial.println(txtLine.length());
#endif

  if (txtLine.charAt(1)==58) {
          line = txtLine.charAt(0) - '0';
          txtLine = txtLine.substring(2);
          txtLine = txtLine.substring(0,COLS);
          if (line >= 0 && line < ROWS) {
            lcd.setCursor(0,line);
	    lcd.print(txtLine);
            if (txtLine.length() <COLS) {
              for (i=txtLine.length(); i<COLS; i++) lcd.write(32);}
          }
	  if (setAck) send72 = true;			// acknowledge message ?
        }
}
break;

default: send92 = true;				// no valid device parsed
}
}	// end parseCmd

//
//
//======================		SENDMSG: sends messages that are flagged for transmission
//

void sendMsg() {					// prepares values to be transmitted
bool tx = false; 					// transmission flag
mes.nodeID=NODEID;
mes.intVal = 0;
mes.fltVal = 0;
mes.cmd = 0;						// '0' means no action needed in gateway
int i;
for ( i = 0; i < sizeof(VERSION); i++){
mes.payLoad[i] = VERSION[i];	}
mes.payLoad[i] = '\0';					// software version in payload string

if (wakeUp) {						// send wakeUp call 
	mes.devID = 99;	
	wakeUp = false;					// reset transmission flag for this message
	txRadio();					// transmit
}
if (send0) {
	mes.devID = 0;
	mes.intVal = upTime;			// minutes uptime
	send0 = false;
	txRadio();
}
if (send1) {						// transmission interval
	mes.devID = 1;
	mes.intVal = TXinterval;			// seconds (integer)
	send1 = false;
	txRadio();
}
if (send2) {
	mes.devID = 2;
	mes.intVal = signalStrength;			// signal strength (integer)
	send2 = false;
	txRadio();
}
if (send3) {						// node software version (string)
	mes.devID = 3;					// already stored in payload string
	send3 = false;
	txRadio();
}
if (send4) {							// measure voltage..
	mes.devID = 4;	
	long result;						// Read 1.1V reference against AVcc
	ADMUX = _BV(REFS0) | _BV(MUX3) | _BV(MUX2) | _BV(MUX1);
	delay(2);						// Wait for Vref to settle
	ADCSRA |= _BV(ADSC);					// Convert
	while (bit_is_set(ADCSRA,ADSC));
	result = ADCL;
	result |= ADCH<<8;
	result = 1126400L / result; 				// Back-calculate in mV
	mes.fltVal = float(result/1000.0);			// Voltage in Volt (float)
	txRadio();
	send4 = false;
}
if (send5) {							// Acknowledge on 'SET'
	mes.devID = 5;
	if (setAck) mes.intVal = 1; else mes.intVal = 0;	// state (integer)
	send5 = false;
	txRadio();
}
if (send40) {							// Button 1 state
	mes.devID = 40;
	if (curStateBtn1) mes.intVal = 1;						// state (integer)
	send40 = false;
	txRadio();
}
if (send41) {							// Button 2 state
	mes.devID = 41;
	if (curStateBtn2) mes.intVal = 1;						// state (integer)
	send41 = false;
	txRadio();
}
if (send72) {
	mes.devID = 72;
	mes.intVal = 1;
	sprintf(mes.payLoad, "text received");
	send72 = false;
	txRadio();
}
if (send92) {							// error message invalid device
	mes.intVal = mes.devID;
	mes.devID = 92;
    send92 = false;
	txRadio();
}

}
//
//
//=======================		TXRADIO
//

void txRadio()							// Transmits the 'mes'-struct to the gateway
{
if (radio.sendWithRetry(GATEWAYID, (const void*)(&mes), sizeof(mes)))
#ifdef DEBUG
	{Serial.print(" message ");
	Serial.print(mes.devID);
	Serial.println(" sent...");}
	else Serial.println("No connection...")
#endif
;}	// end txRadio






